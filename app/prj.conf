## CMakeLists.txt
```
cmake_minimum_required(VERSION 3.13.1)

set(CONFIG_APPLICATION_DEFINED_SYSCALL true)

# Add our custom Zephyr module for drivers w/ syscalls, etc.
list(APPEND DTS_ROOT ${CMAKE_SOURCE_DIR}/drivers/zephyr)

set(ZephyrBuildConfiguration_ROOT ${CMAKE_SOURCE_DIR}/cmake)

list(APPEND ZEPHYR_EXTRA_MODULES
  ${CMAKE_CURRENT_SOURCE_DIR}/drivers
)

# Find Zephyr. This also loads Zephyr's build system.
find_package(Zephyr REQUIRED HINTS ../zephyr)
project(zmk)

zephyr_linker_sources(RODATA include/linker/zmk-events.ld)

# Add your source file to the "app" target. This must come after
# find_package(Zephyr) which defines the target.
target_include_directories(app PRIVATE include)
target_sources(app PRIVATE src/stdlib.c)
target_sources(app PRIVATE src/activity.c)
target_sources(app PRIVATE src/kscan.c)
target_sources(app PRIVATE src/matrix_transform.c)
target_sources(app PRIVATE src/sensors.c)
target_sources_ifdef(CONFIG_ZMK_WPM app PRIVATE src/wpm.c)
target_sources(app PRIVATE src/event_manager.c)
target_sources_ifdef(CONFIG_ZMK_EXT_POWER app PRIVATE src/ext_power_generic.c)
target_sources(app PRIVATE src/events/activity_state_changed.c)
target_sources(app PRIVATE src/events/position_state_changed.c)
target_sources(app PRIVATE src/events/sensor_event.c)
target_sources(app PRIVATE src/events/rgb_cmd_event.c)
target_sources_ifdef(CONFIG_ZMK_WPM app PRIVATE src/events/wpm_state_changed.c)
target_sources_ifdef(CONFIG_USB_DEVICE_STACK app PRIVATE src/events/usb_conn_state_changed.c)
target_sources(app PRIVATE src/behaviors/behavior_reset.c)
target_sources_ifdef(CONFIG_ZMK_EXT_POWER app PRIVATE src/behaviors/behavior_ext_power.c)
if ((NOT CONFIG_ZMK_SPLIT) OR CONFIG_ZMK_SPLIT_ROLE_CENTRAL)
  target_sources(app PRIVATE src/hid.c)
  target_sources(app PRIVATE src/behaviors/behavior_key_press.c)
  target_sources_ifdef(CONFIG_ZMK_BEHAVIOR_KEY_TOGGLE app PRIVATE src/behaviors/behavior_key_toggle.c)
  target_sources(app PRIVATE src/behaviors/behavior_hold_tap.c)
  target_sources(app PRIVATE src/behaviors/behavior_sticky_key.c)
  target_sources(app PRIVATE src/behaviors/behavior_caps_word.c)
  target_sources(app PRIVATE src/behaviors/behavior_key_repeat.c)
  target_sources_ifdef(CONFIG_ZMK_BEHAVIOR_MACRO app PRIVATE src/behaviors/behavior_macro.c)
  target_sources(app PRIVATE src/behaviors/behavior_momentary_layer.c)
  target_sources(app PRIVATE src/behaviors/behavior_mod_morph.c)
  target_sources(app PRIVATE src/behaviors/behavior_outputs.c)
  target_sources(app PRIVATE src/behaviors/behavior_toggle_layer.c)
  target_sources(app PRIVATE src/behaviors/behavior_to_layer.c)
  target_sources(app PRIVATE src/behaviors/behavior_transparent.c)
  target_sources(app PRIVATE src/behaviors/behavior_none.c)
  target_sources_ifdef(CONFIG_ZMK_BEHAVIOR_SENSOR_ROTATE app PRIVATE src/behaviors/behavior_sensor_rotate.c)
  target_sources_ifdef(CONFIG_ZMK_BEHAVIOR_SENSOR_ROTATE_VAR app PRIVATE src/behaviors/behavior_sensor_rotate_var.c)
  target_sources_ifdef(CONFIG_ZMK_BEHAVIOR_SENSOR_ROTATE_COMMON app PRIVATE src/behaviors/behavior_sensor_rotate_common.c)
  #target_sources(app PRIVATE src/behaviors/behavior_sensor_rotate_key_press.c)
  target_sources(app PRIVATE src/behaviors/behavior_sensor_key_press.c)
  target_sources(app PRIVATE src/combo.c)
  target_sources(app PRIVATE src/behaviors/behavior_tap_dance.c)
  target_sources(app PRIVATE src/behavior_queue.c)
  target_sources(app PRIVATE src/conditional_layer.c)
  target_sources(app PRIVATE src/endpoints.c)
  target_sources(app PRIVATE src/events/endpoint_selection_changed.c)
  target_sources(app PRIVATE src/hid_listener.c)
  target_sources(app PRIVATE src/keymap.c)
  target_sources(app PRIVATE src/events/layer_state_changed.c)
  target_sources(app PRIVATE src/events/modifiers_state_changed.c)
  target_sources(app PRIVATE src/events/keycode_state_changed.c)

  if (CONFIG_ZMK_BLE)
    target_sources(app PRIVATE src/events/ble_active_profile_changed.c)
    target_sources(app PRIVATE src/behaviors/behavior_bt.c)
    target_sources(app PRIVATE src/ble.c)
    target_sources(app PRIVATE src/hog.c)
  endif()
endif()

target_sources_ifdef(CONFIG_ZMK_RGB_UNDERGLOW app PRIVATE src/behaviors/behavior_rgb_underglow.c)
target_sources_ifdef(CONFIG_ZMK_BACKLIGHT app PRIVATE src/behaviors/behavior_backlight.c)

target_sources_ifdef(CONFIG_ZMK_BATTERY_REPORTING app PRIVATE src/events/battery_state_changed.c)
target_sources_ifdef(CONFIG_ZMK_BATTERY_REPORTING app PRIVATE src/battery.c)

target_sources_ifdef(CONFIG_ZMK_SPLIT app PRIVATE src/events/split_peripheral_status_changed.c)
add_subdirectory(src/split)

target_sources_ifdef(CONFIG_USB_DEVICE_STACK app PRIVATE src/usb.c)
target_sources_ifdef(CONFIG_ZMK_USB app PRIVATE src/usb_hid.c)
target_sources_ifdef(CONFIG_ZMK_RGB_UNDERGLOW app PRIVATE src/rgb_underglow.c)
target_sources_ifdef(CONFIG_ZMK_BACKLIGHT app PRIVATE src/backlight.c)
target_sources(app PRIVATE src/workqueue.c)
target_sources(app PRIVATE src/main.c)

add_subdirectory(src/display/)

zephyr_cc_option(-Wfatal-errors)
```

## Kconfig
```
# Copyright (c) 2020 The ZMK Contributors
# SPDX-License-Identifier: MIT

mainmenu "ZMK Firmware"

menu "ZMK"

config ZMK_BOARD_COMPAT
    bool
    help
      Hidden symbol used to hint that a board has been specifically
      set up with various ZMK requirements in mind, e.g. settings
      storage, bootloader integration, etc.

      Failure to set this will warn users they may want to verify they
      used a ZMK variant of an upstream board, or are using a board
      properly migrated to a newer ZMK version.

menu "Basic Keyboard Setup"

config ZMK_KEYBOARD_NAME
    string "Keyboard Name"

config USB_DEVICE_PRODUCT
    default ZMK_KEYBOARD_NAME

config BT_DEVICE_NAME
    default ZMK_KEYBOARD_NAME

config USB_DEVICE_VID
    default 0x1D50

config USB_DEVICE_PID
    default 0x615E

config USB_DEVICE_MANUFACTURER
    default "ZMK Project"

config BT_DIS_PNP_VID
    default 0x1D50

config BT_DIS_PNP_PID
    default 0x615E

config BT_DIS_MODEL_NUMBER_STR
    default ZMK_KEYBOARD_NAME

config BT_DIS_MANUF_NAME_STR
    default "ZMK Project"

# Hardware specific overrides

if SOC_SERIES_NRF52X

# Default on for our usage until boards implement retained bootmode.
config NRF_STORE_REBOOT_TYPE_GPREGRET
    bool
    default y

endif # SOC_SERIES_NRF52X

menu "HID"

choice ZMK_HID_REPORT_TYPE
    prompt "HID Report Type"

config ZMK_HID_REPORT_TYPE_HKRO
    bool "#-Key Roll Over (HKRO) HID Report"
    help
      Enable # key roll over for HID report. This selection is "boot keyboard" compatible
      but limits the total number of possible keys to report as held to #.

config ZMK_HID_REPORT_TYPE_NKRO
    bool "Full N-Key Roll Over (NKRO) HID Report"
    help
      Enable full N-Key Roll Over for HID output. This selection will prevent the keyboard
      from working with some BIOS/UEFI versions that only support "boot keyboard" support.
      This option also prevents using some infrequently used higher range HID usages (notably F13-F24 and INTL1-9)
      These usages can be re enabled with ZMK_HID_KEYBOARD_NKRO_EXTENDED_REPORT.

endchoice

config ZMK_HID_KEYBOARD_NKRO_EXTENDED_REPORT
    bool "Enable extended NKRO reporting"
    depends on ZMK_HID_REPORT_TYPE_NKRO
    help
      Enables higher usage range for NKRO (F13-F24 and INTL1-9).
      Please note this is not compatible with Android currently and you will get no input


if ZMK_HID_REPORT_TYPE_HKRO

config ZMK_HID_KEYBOARD_REPORT_SIZE
    int "# Keyboard Keys Reportable"

endif # ZMK_HID_REPORT_TYPE_HKRO

config ZMK_HID_CONSUMER_REPORT_SIZE
    int "# Consumer Keys Reportable"

choice ZMK_HID_CONSUMER_REPORT_USAGES
    prompt "HID Report Type"

config ZMK_HID_CONSUMER_REPORT_USAGES_FULL
    bool "Full Consumer HID Usage Support"
    help
      Enable full Consumer usage ID values to be sent to hosts. Allows for less
      frequently used usages, but has compatibability issues with some host OSes.

config ZMK_HID_CONSUMER_REPORT_USAGES_BASIC
    bool "Basic Consumer HID Usage Support"
    help
      Enable Consumer usage ID values up to "Playback Speed - Slow" to be sent to
      hosts. Allows for broader compatibability with more host OSes.

endchoice

config ZMK_HID_INDICATORS
    bool "HID Indicators"
    help
      Enable HID indicators, used for detecting state of Caps/Scroll/Num Lock,
      Kata, and Compose.

rsource "src/indicators/Kconfig"

config ZMK_HID_SEPARATE_MOD_RELEASE_REPORT
    bool "Release Modifiers Separately"
    help
      Send a separate release event for the modifiers, to make sure the release
      of the modifier doesn't get recognized before the actual key's release event.

menu "Output Types"

config ZMK_USB
    bool "USB"
    depends on (!ZMK_SPLIT || (ZMK_SPLIT && ZMK_SPLIT_ROLE_CENTRAL))
    select USB
    select USB_DEVICE_STACK
    select USB_DEVICE_HID

config ZMK_USB_BOOT
    bool "USB Boot Protocol Support"
    depends on ZMK_USB
    select USB_HID_BOOT_PROTOCOL

config USB_DEVICE_INITIALIZE_AT_BOOT
    default n

if ZMK_USB

config USB_NUMOF_EP_WRITE_RETRIES
    default 10

config USB_HID_POLL_INTERVAL_MS
    default 1

endif # ZMK_USB

menuconfig ZMK_BLE
    bool "BLE (HID over GATT)"
    select BT
    select BT_SMP
    select BT_SMP_SC_PAIR_ONLY
    select BT_SMP_APP_PAIRING_ACCEPT
    select BT_PERIPHERAL
    select BT_DIS
    imply BT_DEVICE_NAME_DYNAMIC
    imply BT_SETTINGS if !ARCH_POSIX
    imply SETTINGS if !ARCH_POSIX
    imply ZMK_BATTERY_REPORTING if !ARCH_POSIX

if ZMK_BLE

config ZMK_BLE_EXPERIMENTAL_CONN
    bool "Experimental BLE connection changes"
    help
      Enables settings that are planned to be default in future versions of ZMK
      to improve connection stability.

config ZMK_BLE_EXPERIMENTAL_SEC
    bool "Experimental BLE security changes"
    imply BT_SMP_ALLOW_UNAUTH_OVERWRITE
    help
      Enables security settings that are planned to be officially supported in the future.

config ZMK_BLE_EXPERIMENTAL_FEATURES
    bool "Experimental BLE connection and security settings/features"
    select ZMK_BLE_EXPERIMENTAL_CONN
    select ZMK_BLE_EXPERIMENTAL_SEC
    help
      Enables experimental connection changes and security features.

config ZMK_BLE_PASSKEY_ENTRY
    bool "Require passkey entry on the keyboard to complete pairing"
    select RING_BUFFER

config BT_SMP_ALLOW_UNAUTH_OVERWRITE
    imply ZMK_BLE_PASSKEY_ENTRY

config BT_CTLR_PHY_2M
    default n if ZMK_BLE_EXPERIMENTAL_CONN

config ZMK_BLE_THREAD_STACK_SIZE
    int "BLE notify thread stack size"
    default 768

config ZMK_BLE_THREAD_PRIORITY
    int "BLE notify thread priority"
    default 5

config ZMK_BLE_KEYBOARD_REPORT_QUEUE_SIZE
    int "Max number of keyboard HID reports to queue for sending over BLE"
    default 20

config ZMK_BLE_CONSUMER_REPORT_QUEUE_SIZE
    int "Max number of consumer HID reports to queue for sending over BLE"
    default 5

config ZMK_BLE_MOUSE_REPORT_QUEUE_SIZE
    int "Max number of mouse HID reports to queue for sending over BLE"
    default 20

config ZMK_BLE_CLEAR_BONDS_ON_START
    bool "Configuration that clears all bond information from the keyboard on startup."

# HID GATT notifications sent this way are *not* picked up by Linux, and possibly others.
config BT_GATT_NOTIFY_MULTIPLE
    default n

config BT_GATT_AUTO_SEC_REQ
    default (ZMK_SPLIT_BLE && !ZMK_SPLIT_ROLE_CENTRAL)

config BT_PERIPHERAL_PREF_MIN_INT
    default 6

config BT_PERIPHERAL_PREF_MAX_INT
    default 12

config BT_PERIPHERAL_PREF_LATENCY
    default 30

config BT_PERIPHERAL_PREF_TIMEOUT
    default 400

# The device name should be 16 characters or less so it fits within the
# advertising data.
config BT_DEVICE_NAME_MAX
    default 16

endif # ZMK_BLE

endmenu # Output Types

endmenu # HID

rsource "src/split/Kconfig"

endmenu # Basic Keyboard Setup

menu "Keymaps"

config ZMK_KEYMAP_LAYER_REORDERING
    bool "Layer Reordering Support"

config ZMK_KEYMAP_SETTINGS_STORAGE
    bool "Settings Save/Load"
    depends on SETTINGS
    depends on ZMK_BEHAVIOR_LOCAL_IDS

if ZMK_KEYMAP_SETTINGS_STORAGE

config ZMK_KEYMAP_LAYER_NAME_MAX_LEN
    int "Max Layer Name Length"
    default 20

endif # ZMK_KEYMAP_SETTINGS_STORAGE

endmenu # Keymaps

rsource "src/studio/Kconfig"

menu "Display/LED Options"

rsource "src/display/Kconfig"

menuconfig ZMK_RGB_UNDERGLOW
    bool "RGB Addressable LED Underglow"
    select LED_STRIP
    select ZMK_LOW_PRIORITY_WORK_QUEUE

if ZMK_RGB_UNDERGLOW

config ZMK_RGB_UNDERGLOW_EXT_POWER
    bool "RGB underglow toggling also controls external power"

config ZMK_RGB_UNDERGLOW_BRT_MIN
    int "RGB underglow minimum brightness in percent"
    range 0 100

config ZMK_RGB_UNDERGLOW_BRT_MAX
    int "RGB underglow maximum brightness in percent"
    range ZMK_RGB_UNDERGLOW_BRT_MIN 100

config ZMK_RGB_UNDERGLOW_HUE_STEP
    int "RGB underglow hue step in degrees"
    range 0 359

config ZMK_RGB_UNDERGLOW_SAT_STEP
    int "RGB underglow saturation step in percent"
    range 0 100

config ZMK_RGB_UNDERGLOW_BRT_STEP
    int "RGB underglow brightness step in percent"
    range 0 100

config ZMK_RGB_UNDERGLOW_HUE_START
    int "RGB underglow start hue value in degrees"
    range 0 359

config ZMK_RGB_UNDERGLOW_SAT_START
    int "RGB underglow start saturations value in percent"
    range 0 100

config ZMK_RGB_UNDERGLOW_BRT_START
    int "RGB underglow start brightness value in percent"
    range ZMK_RGB_UNDERGLOW_BRT_MIN ZMK_RGB_UNDERGLOW_BRT_MAX

config ZMK_RGB_UNDERGLOW_SPD_START
    int "RGB underglow start animation speed value"
    range 1 5

config ZMK_RGB_UNDERGLOW_EFF_START
    int "RGB underglow start effect int value related to the effect enum list"
    range 0 5

config ZMK_RGB_UNDERGLOW_ON_START
    bool "RGB underglow starts on by default"

config ZMK_RGB_UNDERGLOW_AUTO_OFF_IDLE
    bool "Turn off RGB underglow when keyboard goes into idle state"

config ZMK_RGB_UNDERGLOW_AUTO_OFF_USB
    bool "Turn off RGB underglow when USB is disconnected"
    depends on USB_DEVICE_STACK

endif # ZMK_RGB_UNDERGLOW

menuconfig ZMK_BACKLIGHT
    bool "LED backlight"
    select LED

if ZMK_BACKLIGHT

config ZMK_BACKLIGHT_BRT_STEP
    int "Brightness step in percent"
    range 1 100

config ZMK_BACKLIGHT_BRT_START
    int "Default brightness in percent"
    range 1 100

config ZMK_BACKLIGHT_ON_START
    bool "Default backlight state"

config ZMK_BACKLIGHT_AUTO_OFF_IDLE
    bool "Turn off backlight when keyboard goes into idle state"

config ZMK_BACKLIGHT_AUTO_OFF_USB
    bool "Turn off backlight when USB is disconnected"

endif # ZMK_BACKLIGHT

endmenu # Display/LED Options

rsource "src/pointing/Kconfig"

menu "Power Management"

config ZMK_BATTERY_REPORTING
    bool "Battery level detection/reporting"
    select SENSOR
    select ZMK_LOW_PRIORITY_WORK_QUEUE
    imply BT_BAS if ZMK_BLE

if ZMK_BATTERY_REPORTING

choice ZMK_BATTERY_REPORTING_FETCH_MODE
    prompt "Battery Reporting Fetch Mode"

config ZMK_BATTERY_REPORTING_FETCH_MODE_STATE_OF_CHARGE
    bool "State of charge"

config ZMK_BATTERY_REPORTING_FETCH_MODE_LITHIUM_VOLTAGE
    bool "Lithium Voltage"

endchoice

endif # ZMK_BATTERY_REPORTING

config ZMK_IDLE_TIMEOUT
    int "Milliseconds of inactivity before entering idle state (OLED shutoff, etc)"
    default 30000

config ZMK_SLEEP
    bool "Enable deep sleep support"
    depends on HAS_POWEROFF
    select POWEROFF
    select ZMK_PM_DEVICE_SUSPEND_RESUME
    imply USB

if ZMK_SLEEP

config PM_DEVICE
    default y

config ZMK_IDLE_SLEEP_TIMEOUT
    int "Milliseconds of inactivity before entering deep sleep"
    default 900000

endif # ZMK_SLEEP

config ZMK_EXT_POWER
    bool "Enable support to control external power output"

config ZMK_PM
    bool

config ZMK_PM_DEVICE_SUSPEND_RESUME
    bool
    select ZMK_PM

config ZMK_PM_SOFT_OFF
    bool "Soft-off support"
    depends on HAS_POWEROFF
    select ZMK_PM
    select PM_DEVICE
    select ZMK_PM_DEVICE_SUSPEND_RESUME
    select POWEROFF

config ZMK_GPIO_KEY_WAKEUP_TRIGGER
    bool "Hardware supported wakeup (GPIO)"
    default y
    depends on DT_HAS_ZMK_GPIO_KEY_WAKEUP_TRIGGER_ENABLED && ZMK_PM_SOFT_OFF

# Power Management
endmenu

menu "Combo options"

config ZMK_COMBO_MAX_PRESSED_COMBOS
    int "Maximum number of currently pressed combos"
    default 4

config ZMK_COMBO_MAX_COMBOS_PER_KEY
    int "Deprecated: Max combos per key"
    default 0
    help
      Deprecated: Storage for combos is now determined automatically

config ZMK_COMBO_MAX_KEYS_PER_COMBO
    int "Deprecated: Max keys per combo"
    default 0
    help
       Deprecated: This is now auto-calculated based on `key-positions` in devicetree

# Combo options
endmenu

menu "Behavior Options"

config ZMK_BEHAVIORS_QUEUE_SIZE
    int "Maximum number of behaviors to allow queueing from a macro or other complex behavior"
    default 64

rsource "Kconfig.behaviors"

config ZMK_MACRO_DEFAULT_WAIT_MS
    int "Default time to wait (in milliseconds) before triggering the next behavior in macros"
    default 15

config ZMK_MACRO_DEFAULT_TAP_MS
    int "Default time to wait (in milliseconds) between the press and release events of a tapped behavior in macros"
    default 30

endmenu

menu "Advanced"

rsource "src/boot/Kconfig"

menu "Initialization Priorities"

if USB_DEVICE_STACK

config ZMK_USB_INIT_PRIORITY
    int "USB Init Priority"
    default 96

config ZMK_USB_HID_INIT_PRIORITY
    int "USB HID Init Priority"
    default 95

endif # USB

if ZMK_BLE || ZMK_SPLIT_BLE

config ZMK_BLE_INIT_PRIORITY
    int "BLE Init Priority"
    default 50

endif # ZMK_BLE || ZMK_SPLIT_BLE

endmenu # Initialization Priorities

config ZMK_PHYSICAL_LAYOUT_KEY_ROTATION
    bool "Support rotation of keys in physical layouts"
    default y

menuconfig ZMK_KSCAN
    bool "ZMK KScan Integration"
    default y
    select KSCAN

if ZMK_KSCAN

config ZMK_KSCAN_EVENT_QUEUE_SIZE
    int "Size of the event queue for KSCAN events to buffer events"
    default 4

endif # ZMK_KSCAN

config ZMK_KSCAN_SIDEBAND_BEHAVIORS
    bool
    default y
    depends on DT_HAS_ZMK_KSCAN_SIDEBAND_BEHAVIORS_ENABLED
    select KSCAN

if ZMK_KSCAN_SIDEBAND_BEHAVIORS

config ZMK_KSCAN_SIDEBAND_BEHAVIORS_INIT_PRIORITY
    int "Keyboard scan sideband behaviors driver init priority"
    # The default kscan init priority is 90, so be sure we are initialized later.
    default 95

endif # ZMK_KSCAN_SIDEBAND_BEHAVIORS

menu "Logging"

config ZMK_LOGGING_MINIMAL
    bool "Suppress all ZMK debug log messages"
    default false

if !ZMK_LOGGING_MINIMAL

config ZMK_LOG_LEVEL
    default 4

endif

config ZMK_USB_LOGGING
    bool "Enable USB CDC ACM logging to help debug"
    select LOG
    select USB
    select USB_DEVICE_STACK
    select USB_CDC_ACM
    select SERIAL
    select CONSOLE
    select UART_INTERRUPT_DRIVEN
    select UART_LINE_CTRL
    select UART_CONSOLE
    select USB_UART_CONSOLE

if ZMK_USB_LOGGING

choice USB_CDC_ACM_LOG_LEVEL_CHOICE
    default USB_CDC_ACM_LOG_LEVEL_OFF
endchoice

choice USB_DRIVER_LOG_LEVEL_CHOICE
    default USB_DRIVER_LOG_LEVEL_OFF
endchoice

# We do this to avoid log loop where logging to USB generates more log messages.

config USB_CDC_ACM_RINGBUF_SIZE
    default 1024

config LOG_PROCESS_THREAD_STARTUP_DELAY_MS
    default 1000

endif # ZMK_USB_LOGGING

config ZMK_RTT_LOGGING
    bool "Enable RTT logging to help debug"
    select LOG
    select DEBUG
    select ASSERT
    select USE_SEGGER_RTT
    select CONSOLE
    select RTT_CONSOLE

if ZMK_RTT_LOGGING

config SEGGER_RTT_BUFFER_SIZE_UP
    default 8192

endif # ZMK_RTT_LOGGING

if ZMK_USB_LOGGING || ZMK_RTT_LOGGING

config LOG_BUFFER_SIZE
    default 8192

config LOG_PROCESS_THREAD_SLEEP_MS
    default 100

endif # ZMK_USB_LOGGING || ZMK_RTT_LOGGING

endmenu # Logging

if SETTINGS

config ZMK_SETTINGS_RESET_ON_START
    bool "Delete all persistent settings when the keyboard boots"

if ZMK_SETTINGS_RESET_ON_START

config ZMK_SETTINGS_RESET_ON_START_INIT_PRIORITY
    int "Settings Reset ON Start Initialization Priority"
    default 60
    help
      Initialization priority for the settings reset on start. Must be lower priority/
      higher value than FLASH_INIT_PRIORITY if using the NVS/Flash settings backend.

endif # ZMK_SETTINGS_RESET_ON_START

config ZMK_SETTINGS_SAVE_DEBOUNCE
    int "Milliseconds to debounce settings saves"
    default 60000

endif # SETTINGS

config ZMK_BATTERY_REPORT_INTERVAL
    depends on ZMK_BATTERY_REPORTING
    int "Battery level report interval in seconds"

config ZMK_LOW_PRIORITY_WORK_QUEUE
    bool "Work queue for low priority items"

if ZMK_LOW_PRIORITY_WORK_QUEUE

config ZMK_LOW_PRIORITY_THREAD_STACK_SIZE
    int "Low priority thread stack size"
    default 768

config ZMK_LOW_PRIORITY_THREAD_PRIORITY
    int "Low priority thread priority"
    default 10

endif # ZMK_LOW_PRIORITY_WORK_QUEUE

endmenu # Advanced

endmenu # ZMK

if SOC_FAMILY_NORDIC_NRF

config NRF_SOC_VALIDATE_HEADERS_DISABLED
    default y

endif

config KERNEL_BIN_NAME
    default "zmk"

config REBOOT
    default y

config USB_DEVICE_STACK
    default y if HAS_HW_NRF_USBD

config FPU
    default CPU_HAS_FPU

config ZMK_WPM
    bool "Calculate WPM"

config ZMK_KEYMAP_SENSORS
    bool "Enable Keymap Sensors support"
    default y
    depends on DT_HAS_ZMK_KEYMAP_SENSORS_ENABLED
    select SENSOR

if ZMK_KEYMAP_SENSORS

config ZMK_KEYMAP_SENSORS_DEFAULT_TRIGGERS_PER_ROTATION
    int "Default triggers per rotation"
    help
      Unless overridden for a sensor in the board/shield/devicetree, this value
      determines how many times to trigger the bound behavior per full rotation.
      For tactile encoders with detents, this usually should match the number of
      detents per rotation of the encoder.
    default 20

endif # ZMK_KEYMAP_SENSORS

module = ZMK
module-str = zmk
source "subsys/logging/Kconfig.template.log_config"

# This loads ZMK's internal board and shield Kconfigs
rsource "boards/Kconfig"
rsource "boards/shields/*/Kconfig.defconfig"
rsource "boards/shields/*/Kconfig.shield"

# This loads custom shields defconfigs (from BOARD_ROOT)
# Duplicated from Kconfig.zephyr
osource "$(KCONFIG_BINARY_DIR)/Kconfig.shield.defconfig"

# This loads board and shield Kconfigs found under zmk-config/config/
osource "$(ZMK_CONFIG)/boards/shields/*/Kconfig.defconfig"
osource "$(ZMK_CONFIG)/boards/shields/*/Kconfig.shield"

# This loads ZMK's sensible defaults
rsource "Kconfig.defaults"

source "Kconfig.zephyr"
```

## prj.conf
```kconfig
CONFIG_DISPLAY_LOG_LEVEL_WRN=y
```

## dts/behaviors.dtsi
```dts
#include <behaviors/key_press.dtsi>
#include <behaviors/key_toggle.dtsi>
#include <behaviors/transparent.dtsi>
#include <behaviors/none.dtsi>
#include <behaviors/mod_tap.dtsi>
#include <behaviors/layer_tap.dtsi>
#include <behaviors/gresc.dtsi>
#include <behaviors/sticky_key.dtsi>
#include <behaviors/momentary_layer.dtsi>
#include <behaviors/toggle_layer.dtsi>
#include <behaviors/to_layer.dtsi>
#include <behaviors/reset.dtsi>
#include <behaviors/sensor_rotate_key_press.dtsi>
#include <behaviors/sensor_key_press.dtsi>
#include <behaviors/rgb_underglow.dtsi>
#include <behaviors/bluetooth.dtsi>
#include <behaviors/ext_power.dtsi>
#include <behaviors/outputs.dtsi>
#include <behaviors/caps_word.dtsi>
#include <behaviors/key_repeat.dtsi>
#include <behaviors/backlight.dtsi>
#include <behaviors/macros.dtsi>
```

## dts/behaviors/sensor_key_press.dtsi
```dts
/*
 * Copyright (c) 2020 The ZMK Contributors
 *
 * SPDX-License-Identifier: MIT
 */

/ {
	behaviors {
		sens_kp: behavior_sensor_key_press {
			compatible = "zmk,behavior-sensor-key-press";
			label = "SENS_KEY_PRESS";
			#sensor-binding-cells = <1>;
		};
	};
};
```

## dts/bindings/zmk,ledstrip-map.yaml
```yaml
description: |
  Defines a mapping from keymap logical positions to LED physical positions and order in LED strip

compatible: "zmk,ledstrip-map"

properties:
  map:
    type: array
    required: true
  strip-index: 
    type: array
    required: true
```

## dts/bindings/zmk,underglow-map.yaml
```yaml
# Copyright (c) 2026 The ZMK Contributors
# SPDX-License-Identifier: MIT

description: |
  Physical positions of the underglow LEDs, used by the position-aware
  underglow effects (ripple and matrix). Select it with the
  `zmk,underglow-map` chosen node.

  Entries are in "logical" order: first one entry per key position, in the
  same order as the keymap, followed by any LEDs that do not sit under a
  key. The number of entries must equal the `chain-length` of the
  `zmk,underglow` LED strip.

compatible: "zmk,underglow-map"

properties:
  positions:
    type: array
    required: true
    description: |
      One `<x y>` pair per LED, in logical order. Units are arbitrary but
      must be the same for x and y (e.g. 8 per 1u key); larger y is further
      down the keyboard.
  strip-index:
    type: array
    required: true
    description: |
      For each logical entry, the index of that LED in the LED strip chain.
```

## dts/bindings/behaviors/zmk,behavior-sensor-key-press.yaml
```yaml
# Copyright (c) 2020 The ZMK Contributors
# SPDX-License-Identifier: MIT

description: Sensor key press/release behavior

compatible: "zmk,behavior-sensor-key-press"

properties:
  label:
    type: string
    required: true
  "#sensor-binding-cells":
    type: int
    required: true
    const: 1

sensor-binding-cells:
  - param1
```

## src/ble.c
```c
/*
 * Copyright (c) 2020 The ZMK Contributors
 *
 * SPDX-License-Identifier: MIT
 */

#include <zephyr/device.h>
#include <zephyr/init.h>

#include <errno.h>
#include <math.h>
#include <stdlib.h>
#include <stdio.h>

#include <zephyr/settings/settings.h>
#include <zephyr/sys/ring_buffer.h>
#include <zephyr/bluetooth/bluetooth.h>
#include <zephyr/bluetooth/conn.h>
#include <zephyr/bluetooth/hci.h>
#include <zephyr/bluetooth/uuid.h>
#include <zephyr/bluetooth/gatt.h>
#include <zephyr/bluetooth/hci_err.h>

#if IS_ENABLED(CONFIG_SETTINGS)

#include <zephyr/settings/settings.h>

#endif

#include <zephyr/logging/log.h>

LOG_MODULE_DECLARE(zmk, CONFIG_ZMK_LOG_LEVEL);

#include <zmk/ble.h>
#include <zmk/keys.h>
#include <zmk/split/bluetooth/uuid.h>
#include <zmk/event_manager.h>
#include <zmk/events/ble_active_profile_changed.h>

#if IS_ENABLED(CONFIG_ZMK_BLE_PASSKEY_ENTRY)
#include <zmk/events/keycode_state_changed.h>

#define PASSKEY_DIGITS 6

static struct bt_conn *auth_passkey_entry_conn;
RING_BUF_DECLARE(passkey_entries, PASSKEY_DIGITS);

#endif /* IS_ENABLED(CONFIG_ZMK_BLE_PASSKEY_ENTRY) */

enum advertising_type {
    ZMK_ADV_NONE,
    ZMK_ADV_DIR,
    ZMK_ADV_CONN,
} advertising_status;

#define CURR_ADV(adv) (adv << 4)

#define ZMK_ADV_CONN_NAME                                                                          \
    BT_LE_ADV_PARAM(BT_LE_ADV_OPT_CONNECTABLE | BT_LE_ADV_OPT_ONE_TIME, BT_GAP_ADV_FAST_INT_MIN_2, \
                    BT_GAP_ADV_FAST_INT_MAX_2, NULL)

static struct zmk_ble_profile profiles[ZMK_BLE_PROFILE_COUNT];
static uint8_t active_profile;

#define DEVICE_NAME CONFIG_BT_DEVICE_NAME
#define DEVICE_NAME_LEN (sizeof(DEVICE_NAME) - 1)

BUILD_ASSERT(DEVICE_NAME_LEN <= 16, "ERROR: BLE device name is too long. Max length: 16");

static const struct bt_data zmk_ble_ad[] = {
    BT_DATA(BT_DATA_NAME_COMPLETE, DEVICE_NAME, DEVICE_NAME_LEN),
    BT_DATA_BYTES(BT_DATA_GAP_APPEARANCE, 0xC1, 0x03),
    BT_DATA_BYTES(BT_DATA_FLAGS, (BT_LE_AD_GENERAL | BT_LE_AD_NO_BREDR)),
    BT_DATA_BYTES(BT_DATA_UUID16_SOME, 0x12, 0x18, /* HID Service */
                  0x0f, 0x18                       /* Battery Service */
                  ),
};

#if IS_ENABLED(CONFIG_ZMK_SPLIT_ROLE_CENTRAL)

static bt_addr_le_t peripheral_addrs[ZMK_SPLIT_BLE_PERIPHERAL_COUNT];

#endif /* IS_ENABLED(CONFIG_ZMK_SPLIT_ROLE_CENTRAL) */

static void raise_profile_changed_event() {
    ZMK_EVENT_RAISE(new_zmk_ble_active_profile_changed((struct zmk_ble_active_profile_changed){
        .index = active_profile, .profile = &profiles[active_profile]}));
}

static void raise_profile_changed_event_callback(struct k_work *work) {
    raise_profile_changed_event();
}

K_WORK_DEFINE(raise_profile_changed_event_work, raise_profile_changed_event_callback);

bool zmk_ble_active_profile_is_open() {
    return !bt_addr_le_cmp(&profiles[active_profile].peer, BT_ADDR_LE_ANY);
}

void set_profile_address(uint8_t index, const bt_addr_le_t *addr) {
    char setting_name[17] = {0};
    char addr_str[BT_ADDR_LE_STR_LEN];

    bt_addr_le_to_str(addr, addr_str, sizeof(addr_str));

    memcpy(&profiles[index].peer, addr, sizeof(bt_addr_le_t));
    sprintf(setting_name, "ble/profiles/%d", index);
    LOG_DBG("Setting profile addr for %s to %s", setting_name, addr_str);
    settings_save_one(setting_name, &profiles[index], sizeof(struct zmk_ble_profile));
    k_work_submit(&raise_profile_changed_event_work);
}

bool zmk_ble_active_profile_is_connected() {
    struct bt_conn *conn;
    struct bt_conn_info info;
    bt_addr_le_t *addr = zmk_ble_active_profile_addr();
    if (!bt_addr_le_cmp(addr, BT_ADDR_LE_ANY)) {
        return false;
    } else if ((conn = bt_conn_lookup_addr_le(BT_ID_DEFAULT, addr)) == NULL) {
        return false;
    }

    bt_conn_get_info(conn, &info);

    bt_conn_unref(conn);

    return info.state == BT_CONN_STATE_CONNECTED;
}

#define CHECKED_ADV_STOP()                                                                         \
    err = bt_le_adv_stop();                                                                        \
    advertising_status = ZMK_ADV_NONE;                                                             \
    if (err) {                                                                                     \
        LOG_ERR("Failed to stop advertising (err %d)", err);                                       \
        return err;                                                                                \
    }

#define CHECKED_DIR_ADV()                                                                          \
    addr = zmk_ble_active_profile_addr();                                                          \
    conn = bt_conn_lookup_addr_le(BT_ID_DEFAULT, addr);                                            \
    if (conn != NULL) { /* TODO: Check status of connection */                                     \
        LOG_DBG("Skipping advertising, profile host is already connected");                        \
        bt_conn_unref(conn);                                                                       \
        return 0;                                                                                  \
    }                                                                                              \
    err = bt_le_adv_start(BT_LE_ADV_CONN_DIR_LOW_DUTY(addr), zmk_ble_ad, ARRAY_SIZE(zmk_ble_ad),   \
                          NULL, 0);                                                                \
    if (err) {                                                                                     \
        LOG_ERR("Advertising failed to start (err %d)", err);                                      \
        return err;                                                                                \
    }                                                                                              \
    advertising_status = ZMK_ADV_DIR;

#define CHECKED_OPEN_ADV()                                                                         \
    err = bt_le_adv_start(ZMK_ADV_CONN_NAME, zmk_ble_ad, ARRAY_SIZE(zmk_ble_ad), NULL, 0);         \
    if (err) {                                                                                     \
        LOG_ERR("Advertising failed to start (err %d)", err);                                      \
        return err;                                                                                \
    }                                                                                              \
    advertising_status = ZMK_ADV_CONN;

int update_advertising() {
    int err = 0;
    bt_addr_le_t *addr;
    struct bt_conn *conn;
    enum advertising_type desired_adv = ZMK_ADV_NONE;

    if (zmk_ble_active_profile_is_open()) {
        desired_adv = ZMK_ADV_CONN;
    } else if (!zmk_ble_active_profile_is_connected()) {
        desired_adv = ZMK_ADV_CONN;
        // Need to fix directed advertising for privacy centrals. See
        // https://github.com/zephyrproject-rtos/zephyr/pull/14984 char
        // addr_str[BT_ADDR_LE_STR_LEN]; bt_addr_le_to_str(zmk_ble_active_profile_addr(), addr_str,
        // sizeof(addr_str));

        // LOG_DBG("Directed advertising to %s", addr_str);
        // desired_adv = ZMK_ADV_DIR;
    }
    LOG_DBG("advertising from %d to %d", advertising_status, desired_adv);

    switch (desired_adv + CURR_ADV(advertising_status)) {
    case ZMK_ADV_NONE + CURR_ADV(ZMK_ADV_DIR):
    case ZMK_ADV_NONE + CURR_ADV(ZMK_ADV_CONN):
        CHECKED_ADV_STOP();
        break;
    case ZMK_ADV_DIR + CURR_ADV(ZMK_ADV_DIR):
    case ZMK_ADV_DIR + CURR_ADV(ZMK_ADV_CONN):
        CHECKED_ADV_STOP();
        CHECKED_DIR_ADV();
        break;
    case ZMK_ADV_DIR + CURR_ADV(ZMK_ADV_NONE):
        CHECKED_DIR_ADV();
        break;
    case ZMK_ADV_CONN + CURR_ADV(ZMK_ADV_DIR):
        CHECKED_ADV_STOP();
        CHECKED_OPEN_ADV();
        break;
    case ZMK_ADV_CONN + CURR_ADV(ZMK_ADV_NONE):
        CHECKED_OPEN_ADV();
        break;
    }

    return 0;
};

static void update_advertising_callback(struct k_work *work) { update_advertising(); }

K_WORK_DEFINE(update_advertising_work, update_advertising_callback);

int zmk_ble_clear_bonds() {
    LOG_DBG("");

    if (bt_addr_le_cmp(&profiles[active_profile].peer, BT_ADDR_LE_ANY)) {
        LOG_DBG("Unpairing!");
        bt_unpair(BT_ID_DEFAULT, &profiles[active_profile].peer);
        set_profile_address(active_profile, BT_ADDR_LE_ANY);
    }

    update_advertising();

    return 0;
};

int zmk_ble_active_profile_index() { return active_profile; }

#if IS_ENABLED(CONFIG_SETTINGS)
static void ble_save_profile_work(struct k_work *work) {
    settings_save_one("ble/active_profile", &active_profile, sizeof(active_profile));
}

static struct k_work_delayable ble_save_work;
#endif

static int ble_save_profile() {
#if IS_ENABLED(CONFIG_SETTINGS)
    return k_work_reschedule(&ble_save_work, K_MSEC(CONFIG_ZMK_SETTINGS_SAVE_DEBOUNCE));
#else
    return 0;
#endif
}

int zmk_ble_prof_select(uint8_t index) {
    if (index >= ZMK_BLE_PROFILE_COUNT) {
        return -ERANGE;
    }

    LOG_DBG("profile %d", index);
    if (active_profile == index) {
        return 0;
    }

    active_profile = index;
    ble_save_profile();

    update_advertising();

    raise_profile_changed_event();

    return 0;
};

int zmk_ble_prof_next() {
    LOG_DBG("");
    return zmk_ble_prof_select((active_profile + 1) % ZMK_BLE_PROFILE_COUNT);
};

int zmk_ble_prof_prev() {
    LOG_DBG("");
    return zmk_ble_prof_select((active_profile + ZMK_BLE_PROFILE_COUNT - 1) %
                               ZMK_BLE_PROFILE_COUNT);
};

bt_addr_le_t *zmk_ble_active_profile_addr() { return &profiles[active_profile].peer; }

char *zmk_ble_active_profile_name() { return profiles[active_profile].name; }

#if IS_ENABLED(CONFIG_ZMK_SPLIT_ROLE_CENTRAL)

int zmk_ble_put_peripheral_addr(const bt_addr_le_t *addr) {
    for (int i = 0; i < ZMK_SPLIT_BLE_PERIPHERAL_COUNT; i++) {
        // If the address is recognized and already stored in settings, return
        // index and no additional action is necessary.
        if (bt_addr_le_cmp(&peripheral_addrs[i], addr) == 0) {
            LOG_DBG("Found existing peripheral address in slot %d", i);
            return i;
        } else {
            char addr_str[BT_ADDR_LE_STR_LEN];
            bt_addr_le_to_str(&peripheral_addrs[i], addr_str, sizeof(addr_str));
            LOG_DBG("peripheral slot %d occupied by %s", i, addr_str);
        }

        // If the peripheral address slot is open, store new peripheral in the
        // slot and return index. This compares against BT_ADDR_LE_ANY as that
        // is the zero value.
        if (bt_addr_le_cmp(&peripheral_addrs[i], BT_ADDR_LE_ANY) == 0) {
            char addr_str[BT_ADDR_LE_STR_LEN];
            bt_addr_le_to_str(addr, addr_str, sizeof(addr_str));
            LOG_DBG("Storing peripheral %s in slot %d", addr_str, i);
            bt_addr_le_copy(&peripheral_addrs[i], addr);

            char setting_name[32];
            sprintf(setting_name, "ble/peripheral_addresses/%d", i);
            settings_save_one(setting_name, addr, sizeof(bt_addr_le_t));

            return i;
        }
    }

    // The peripheral does not match a known peripheral and there is no
    // available slot.
    return -ENOMEM;
}

#endif /* IS_ENABLED(CONFIG_ZMK_SPLIT_ROLE_CENTRAL) */

#if IS_ENABLED(CONFIG_SETTINGS)

static int ble_profiles_handle_set(const char *name, size_t len, settings_read_cb read_cb,
                                   void *cb_arg) {
    const char *next;

    LOG_DBG("Setting BLE value %s", name);

    if (settings_name_steq(name, "profiles", &next) && next) {
        char *endptr;
        uint8_t idx = strtoul(next, &endptr, 10);
        if (*endptr != '\0') {
            LOG_WRN("Invalid profile index: %s", next);
            return -EINVAL;
        }

        if (len != sizeof(struct zmk_ble_profile)) {
            LOG_ERR("Invalid profile size (got %d expected %d)", len,
                    sizeof(struct zmk_ble_profile));
            return -EINVAL;
        }

        if (idx >= ZMK_BLE_PROFILE_COUNT) {
            LOG_WRN("Profile address for index %d is larger than max of %d", idx,
                    ZMK_BLE_PROFILE_COUNT);
            return -EINVAL;
        }

        int err = read_cb(cb_arg, &profiles[idx], sizeof(struct zmk_ble_profile));
        if (err <= 0) {
            LOG_ERR("Failed to handle profile address from settings (err %d)", err);
            return err;
        }

        char addr_str[BT_ADDR_LE_STR_LEN];
        bt_addr_le_to_str(&profiles[idx].peer, addr_str, sizeof(addr_str));

        LOG_DBG("Loaded %s address for profile %d", addr_str, idx);
    } else if (settings_name_steq(name, "active_profile", &next) && !next) {
        if (len != sizeof(active_profile)) {
            return -EINVAL;
        }

        int err = read_cb(cb_arg, &active_profile, sizeof(active_profile));
        if (err <= 0) {
            LOG_ERR("Failed to handle active profile from settings (err %d)", err);
            return err;
        }
    }
#if IS_ENABLED(CONFIG_ZMK_SPLIT_ROLE_CENTRAL)
    else if (settings_name_steq(name, "peripheral_addresses", &next) && next) {
        if (len != sizeof(bt_addr_le_t)) {
            return -EINVAL;
        }

        int i = atoi(next);
        if (i < 0 || i >= ZMK_SPLIT_BLE_PERIPHERAL_COUNT) {
            LOG_ERR("Failed to store peripheral address in memory");
        } else {
            int err = read_cb(cb_arg, &peripheral_addrs[i], sizeof(bt_addr_le_t));
            if (err <= 0) {
                LOG_ERR("Failed to handle peripheral address from settings (err %d)", err);
                return err;
            }
        }
    }
#endif

    return 0;
};

struct settings_handler profiles_handler = {.name = "ble", .h_set = ble_profiles_handle_set};
#endif /* IS_ENABLED(CONFIG_SETTINGS) */

static bool is_conn_active_profile(const struct bt_conn *conn) {
    return bt_addr_le_cmp(bt_conn_get_dst(conn), &profiles[active_profile].peer) == 0;
}

static void connected(struct bt_conn *conn, uint8_t err) {
    char addr[BT_ADDR_LE_STR_LEN];
    struct bt_conn_info info;
    LOG_DBG("Connected thread: %p", k_current_get());

    bt_conn_get_info(conn, &info);

    if (info.role != BT_CONN_ROLE_PERIPHERAL) {
        LOG_DBG("SKIPPING FOR ROLE %d", info.role);
        return;
    }

    bt_addr_le_to_str(bt_conn_get_dst(conn), addr, sizeof(addr));
    advertising_status = ZMK_ADV_NONE;

    if (err) {
        LOG_WRN("Failed to connect to %s (%u)", addr, err);
        update_advertising();
        return;
    }

    LOG_DBG("Connected %s", addr);

    if (bt_conn_set_security(conn, BT_SECURITY_L2)) {
        LOG_ERR("Failed to set security");
    }

    update_advertising();

    if (is_conn_active_profile(conn)) {
        LOG_DBG("Active profile connected");
        k_work_submit(&raise_profile_changed_event_work);
    }
}

static void disconnected(struct bt_conn *conn, uint8_t reason) {
    char addr[BT_ADDR_LE_STR_LEN];
    struct bt_conn_info info;

    bt_addr_le_to_str(bt_conn_get_dst(conn), addr, sizeof(addr));

    LOG_DBG("Disconnected from %s (reason 0x%02x)", addr, reason);

    bt_conn_get_info(conn, &info);

    if (info.role != BT_CONN_ROLE_PERIPHERAL) {
        LOG_DBG("SKIPPING FOR ROLE %d", info.role);
        return;
    }

    // We need to do this in a work callback, otherwise the advertising update will still see the
    // connection for a profile as active, and not start advertising yet.
    k_work_submit(&update_advertising_work);

    if (is_conn_active_profile(conn)) {
        LOG_DBG("Active profile disconnected");
        k_work_submit(&raise_profile_changed_event_work);
    }
}

static void security_changed(struct bt_conn *conn, bt_security_t level, enum bt_security_err err) {
    char addr[BT_ADDR_LE_STR_LEN];

    bt_addr_le_to_str(bt_conn_get_dst(conn), addr, sizeof(addr));

    if (!err) {
        LOG_DBG("Security changed: %s level %u", addr, level);
    } else {
        LOG_ERR("Security failed: %s level %u err %d", addr, level, err);
    }
}

static void le_param_updated(struct bt_conn *conn, uint16_t interval, uint16_t latency,
                             uint16_t timeout) {
    char addr[BT_ADDR_LE_STR_LEN];

    bt_addr_le_to_str(bt_conn_get_dst(conn), addr, sizeof(addr));

    LOG_DBG("%s: interval %d latency %d timeout %d", addr, interval, latency, timeout);
}

static struct bt_conn_cb conn_callbacks = {
    .connected = connected,
    .disconnected = disconnected,
    .security_changed = security_changed,
    .le_param_updated = le_param_updated,
};

/*
static void auth_passkey_display(struct bt_conn *conn, unsigned int passkey) {
    char addr[BT_ADDR_LE_STR_LEN];

    bt_addr_le_to_str(bt_conn_get_dst(conn), addr, sizeof(addr));

    LOG_DBG("Passkey for %s: %06u", addr, passkey);
}
*/

#if IS_ENABLED(CONFIG_ZMK_BLE_PASSKEY_ENTRY)

static void auth_passkey_entry(struct bt_conn *conn) {
    char addr[BT_ADDR_LE_STR_LEN];

    bt_addr_le_to_str(bt_conn_get_dst(conn), addr, sizeof(addr));

    LOG_DBG("Passkey entry requested for %s", addr);
    ring_buf_reset(&passkey_entries);
    auth_passkey_entry_conn = bt_conn_ref(conn);
}

#endif

static void auth_cancel(struct bt_conn *conn) {
    char addr[BT_ADDR_LE_STR_LEN];

    bt_addr_le_to_str(bt_conn_get_dst(conn), addr, sizeof(addr));

#if IS_ENABLED(CONFIG_ZMK_BLE_PASSKEY_ENTRY)
    if (auth_passkey_entry_conn) {
        bt_conn_unref(auth_passkey_entry_conn);
        auth_passkey_entry_conn = NULL;
    }

    ring_buf_reset(&passkey_entries);
#endif

    LOG_DBG("Pairing cancelled: %s", addr);
}

static enum bt_security_err auth_pairing_accept(struct bt_conn *conn,
                                                const struct bt_conn_pairing_feat *const feat) {
    struct bt_conn_info info;
    bt_conn_get_info(conn, &info);

    LOG_DBG("role %d, open? %s", info.role, zmk_ble_active_profile_is_open() ? "yes" : "no");
    if (info.role == BT_CONN_ROLE_PERIPHERAL && !zmk_ble_active_profile_is_open()) {
        LOG_WRN("Rejecting pairing request to taken profile %d", active_profile);
        return BT_SECURITY_ERR_PAIR_NOT_ALLOWED;
    }

    return BT_SECURITY_ERR_SUCCESS;
};

static void auth_pairing_complete(struct bt_conn *conn, bool bonded) {
    struct bt_conn_info info;
    char addr[BT_ADDR_LE_STR_LEN];
    const bt_addr_le_t *dst = bt_conn_get_dst(conn);

    bt_addr_le_to_str(dst, addr, sizeof(addr));
    bt_conn_get_info(conn, &info);

    if (info.role != BT_CONN_ROLE_PERIPHERAL) {
        LOG_DBG("SKIPPING FOR ROLE %d", info.role);
        return;
    }

    if (!zmk_ble_active_profile_is_open()) {
        LOG_ERR("Pairing completed but current profile is not open: %s", addr);
        bt_unpair(BT_ID_DEFAULT, dst);
        return;
    }

    set_profile_address(active_profile, dst);
    update_advertising();
};

static struct bt_conn_auth_cb zmk_ble_auth_cb_display = {
    .pairing_accept = auth_pairing_accept,
// .passkey_display = auth_passkey_display,

#if IS_ENABLED(CONFIG_ZMK_BLE_PASSKEY_ENTRY)
    .passkey_entry = auth_passkey_entry,
#endif
    .cancel = auth_cancel,
};

static struct bt_conn_auth_info_cb zmk_ble_auth_info_cb_display = {
    .pairing_complete = auth_pairing_complete,
};

static void zmk_ble_ready(int err) {
    LOG_DBG("ready? %d", err);
    if (err) {
        LOG_ERR("Bluetooth init failed (err %d)", err);
        return;
    }

    update_advertising();
}

static int zmk_ble_init(const struct device *_arg) {
    int err = bt_enable(NULL);

    if (err) {
        LOG_ERR("BLUETOOTH FAILED (%d)", err);
        return err;
    }

#if IS_ENABLED(CONFIG_SETTINGS)
    settings_subsys_init();

    err = settings_register(&profiles_handler);
    if (err) {
        LOG_ERR("Failed to setup the profile settings handler (err %d)", err);
        return err;
    }

    k_work_init_delayable(&ble_save_work, ble_save_profile_work);

    settings_load_subtree("ble");
    settings_load_subtree("bt");

#endif

#if IS_ENABLED(CONFIG_ZMK_BLE_CLEAR_BONDS_ON_START)
    LOG_WRN("Clearing all existing BLE bond information from the keyboard");

    bt_unpair(BT_ID_DEFAULT, NULL);

    for (int i = 0; i < ZMK_BLE_PROFILE_COUNT; i++) {
        char setting_name[17] = {0};
        sprintf(setting_name, "ble/profiles/%d", i);

        err = settings_delete(setting_name);
        if (err) {
            LOG_ERR("Failed to delete setting: %d", err);
        }
    }

    // Hardcoding a reasonable hardcoded value of peripheral addresses
    // to clear so we properly clear a split central as well.
    for (int i = 0; i < 8; i++) {
        char setting_name[32];
        sprintf(setting_name, "ble/peripheral_addresses/%d", i);

        err = settings_delete(setting_name);
        if (err) {
            LOG_ERR("Failed to delete setting: %d", err);
        }
    }

#endif // IS_ENABLED(CONFIG_ZMK_BLE_CLEAR_BONDS_ON_START)

    bt_conn_cb_register(&conn_callbacks);
    bt_conn_auth_cb_register(&zmk_ble_auth_cb_display);
    bt_conn_auth_info_cb_register(&zmk_ble_auth_info_cb_display);

    zmk_ble_ready(0);

    return 0;
}

#if IS_ENABLED(CONFIG_ZMK_BLE_PASSKEY_ENTRY)

static bool zmk_ble_numeric_usage_to_value(const zmk_key_t key, const zmk_key_t one,
                                           const zmk_key_t zero, uint8_t *value) {
    if (key < one || key > zero) {
        return false;
    }

    *value = (key == zero) ? 0 : (key - one + 1);
    return true;
}

static int zmk_ble_handle_key_user(struct zmk_keycode_state_changed *event) {
    zmk_key_t key = event->keycode;

    LOG_DBG("key %d", key);

    if (!auth_passkey_entry_conn) {
        LOG_DBG("No connection for passkey entry");
        return ZMK_EV_EVENT_BUBBLE;
    }

    if (!event->state) {
        LOG_DBG("Key released, ignoring");
        return ZMK_EV_EVENT_BUBBLE;
    }

    if (key == HID_USAGE_KEY_KEYBOARD_ESCAPE) {
        bt_conn_auth_cancel(auth_passkey_entry_conn);
        return ZMK_EV_EVENT_HANDLED;
    }

    if (key == HID_USAGE_KEY_KEYBOARD_RETURN || key == HID_USAGE_KEY_KEYBOARD_RETURN_ENTER) {
        uint8_t digits[PASSKEY_DIGITS];
        uint32_t count = ring_buf_get(&passkey_entries, digits, PASSKEY_DIGITS);

        uint32_t passkey = 0;
        for (int i = 0; i < count; i++) {
            passkey = (passkey * 10) + digits[i];
        }

        LOG_DBG("Final passkey: %d", passkey);
        bt_conn_auth_passkey_entry(auth_passkey_entry_conn, passkey);
        bt_conn_unref(auth_passkey_entry_conn);
        auth_passkey_entry_conn = NULL;
        return ZMK_EV_EVENT_HANDLED;
    }

    uint8_t val;
    if (!(zmk_ble_numeric_usage_to_value(key, HID_USAGE_KEY_KEYBOARD_1_AND_EXCLAMATION,
                                         HID_USAGE_KEY_KEYBOARD_0_AND_RIGHT_PARENTHESIS, &val) ||
          zmk_ble_numeric_usage_to_value(key, HID_USAGE_KEY_KEYPAD_1_AND_END,
                                         HID_USAGE_KEY_KEYPAD_0_AND_INSERT, &val))) {
        LOG_DBG("Key not a number, ignoring");
        return ZMK_EV_EVENT_BUBBLE;
    }

    if (ring_buf_space_get(&passkey_entries) <= 0) {
        uint8_t discard_val;
        ring_buf_get(&passkey_entries, &discard_val, 1);
    }
    ring_buf_put(&passkey_entries, &val, 1);
    LOG_DBG("value entered: %d, digits collected so far: %d", val,
            ring_buf_size_get(&passkey_entries));

    return ZMK_EV_EVENT_HANDLED;
}

static int zmk_ble_listener(const zmk_event_t *eh) {
    struct zmk_keycode_state_changed *kc_state;

    kc_state = as_zmk_keycode_state_changed(eh);

    if (kc_state != NULL) {
        return zmk_ble_handle_key_user(kc_state);
    }

    return 0;
}

ZMK_LISTENER(zmk_ble, zmk_ble_listener);
ZMK_SUBSCRIPTION(zmk_ble, zmk_keycode_state_changed);
#endif /* IS_ENABLED(CONFIG_ZMK_BLE_PASSKEY_ENTRY) */

SYS_INIT(zmk_ble_init, APPLICATION, CONFIG_ZMK_BLE_INIT_PRIORITY);
```
