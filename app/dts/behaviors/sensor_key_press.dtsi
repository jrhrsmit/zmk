/*
 * Copyright (c) 2020 The ZMK Contributors
 *
 * SPDX-License-Identifier: MIT
 */

/ {
	behaviors {
		sens_kp: behavior_sensor_key_press {
			compatible = "zmk,behavior-sensor-key-press";
			label = "SENS_KEY_PRESS";
			#sensor-binding-cells = <1>;
		};
	};
};
