## app/drivers/sensor/capsense/Kconfig
```kconfig
# Copyright (c) 2020 The ZMK Contributors
# SPDX-License-Identifier: MIT

menuconfig CAPSENSE
	bool "Capacitive sensor"
	depends on ADC && GPIO
	help
	  Enable driver for capacitive sensors

if CAPSENSE

endif # CAPSENSE
```

## app/drivers/sensor/csense/Kconfig
```kconfig
# Copyright (c) 2020 The ZMK Contributors
# SPDX-License-Identifier: MIT

menuconfig CSENSE
	bool "Capacitive sensor for nRF5"
	depends on GPIO
	help
	  Enable driver for capacitive sensors for the Nordic nRF5 series

if CSENSE

config CSENSE_THREAD_PRIORITY
	int "Thread priority"
	default 10
	help
	  Priority of thread used by the driver to handle interrupts.

config CSENSE_THREAD_STACK_SIZE
	int "Thread stack size"
	default 128
	help
	  Stack size of thread used by the driver to handle interrupts.

endif # CSENSE
```

## app/drivers/zephyr/dts/bindings/sensor/nrf,csense.yaml
```yaml
description: |
  Sensor driver for the nRF5 capacitive sensor

compatible: "nordic,csense"

properties:
  label:
    type: string
    required: true
  gpios:
    type: phandle-array
    required: false
      #io-channels:
      #  type: phandle-array
      #  description: The pin that is connected to the capacitive button
      #  required: true
```

## app/drivers/zephyr/dts/bindings/sensor/zmk,capsense.yaml
```yaml
description: |
  Sensor driver for capacitive sensor

compatible: "zmk,capsense"

properties:
  label:
    type: string
    required: true
  gpios:
    type: phandle-array
    description: The pin used for charging the capacitor, can be the same as the ADC pin
    required: true 
  io-channels:
    type: phandle-array
    description: The ADC pin that is connected to the to the capacitive button for the LPCOMP
    required: true
  threshold_grounded:
    type: int
    description: Difference in TIMER ticks to trigger the event for turning on the keyboard
    required: false
    default: 15
  threshold_wireless:
    type: int
    description: Difference in TIMER ticks to trigger the event for turning on the keyboard
    required: false
    default: 10
  buffer_size:
    type: int
    required: false
    default: 8
  num_samples:
    type: int
    required: false
    default: 64
  sample_period:
    type: int
    required: false
    default: 250
```
