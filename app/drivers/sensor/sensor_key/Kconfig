## app/drivers/sensor/sensor_key/Kconfig
```kconfig
# Copyright (c) 2020 The ZMK Contributors
# SPDX-License-Identifier: MIT

menuconfig SENSOR_KEY
	bool "SENSOR_KEY GPIO key sensor"
	depends on GPIO
	help
	  Enable driver for SENSOR_KEY GPIO key sensors.

if SENSOR_KEY

choice
	prompt "Trigger mode"
	default SENSOR_KEY_TRIGGER_NONE
	help
	  Specify the type of triggering to be used by the driver.

config SENSOR_KEY_TRIGGER_NONE
	bool "No trigger"

config SENSOR_KEY_TRIGGER_GLOBAL_THREAD
	bool "Use global thread"
	depends on GPIO
	select SENSOR_KEY_TRIGGER

config SENSOR_KEY_TRIGGER_OWN_THREAD
	bool "Use own thread"
	depends on GPIO
	select SENSOR_KEY_TRIGGER

endchoice

config SENSOR_KEY_TRIGGER
	bool

config SENSOR_KEY_THREAD_PRIORITY
	int "Thread priority"
	depends on SENSOR_KEY_TRIGGER_OWN_THREAD
	default 10
	help
	  Priority of thread used by the driver to handle interrupts.

config SENSOR_KEY_THREAD_STACK_SIZE
	int "Thread stack size"
	depends on SENSOR_KEY_TRIGGER_OWN_THREAD
	default 256
	help
	  Stack size of thread used by the driver to handle interrupts.

endif # SENSOR_KEY
```

## app/drivers/zephyr/dts/bindings/sensor/zmk,sensor-key.yaml
```yaml
description: |
  Sensor driver for a single key

compatible: "zmk,sensor-key"

properties:
  label:
    type: string
    required: true
  gpios:
    type: phandle-array
    required: true
    description: The gpio for the input key
```

## app/src/display/widgets/Kconfig
```kconfig
# Copyright (c) 2020 The ZMK Contributors
# SPDX-License-Identifier: MIT

menu "ZMK Display Widgets"

config ZMK_WIDGET_LAYER_STATUS
    bool "Widget for highest, active layer using small icons"
    depends on !ZMK_SPLIT || ZMK_SPLIT_ROLE_CENTRAL
    select LV_USE_LABEL

config ZMK_WIDGET_BATTERY_STATUS
    bool "Widget for battery charge information, using small icons"
    depends on BT
    select LV_USE_LABEL

if ZMK_WIDGET_BATTERY_STATUS

config ZMK_WIDGET_BATTERY_STATUS_SHOW_PERCENTAGE
    bool "Show battery level percentage in text"

endif

config ZMK_WIDGET_OUTPUT_STATUS
    bool "Widget for keyboard output status icons"
    depends on BT && (!ZMK_SPLIT_BLE || ZMK_SPLIT_ROLE_CENTRAL)
    select LV_USE_LABEL

config ZMK_WIDGET_PERIPHERAL_STATUS
    bool "Widget for split peripheral status icons"
    depends on BT && ZMK_SPLIT_BLE && !ZMK_SPLIT_ROLE_CENTRAL
    select LV_USE_LABEL

config ZMK_WIDGET_WPM_STATUS
    bool "Widget for displaying typed words per minute"
    depends on !ZMK_SPLIT || ZMK_SPLIT_ROLE_CENTRAL
    select LV_USE_LABEL
    select ZMK_WPM

config ZMK_WIDGET_CUSTOM_STATUS
    bool "Widget for displaying a custom status screen"
    depends on !ZMK_SPLIT || ZMK_SPLIT_ROLE_CENTRAL
    select LV_USE_IMG

config ZMK_WIDGET_BOOT_SCREEN_STATUS
    bool "Widget for displaying a boot screen"
    depends on !ZMK_SPLIT || ZMK_SPLIT_ROLE_CENTRAL
    select LV_USE_IMG

config ZMK_WIDGET_RGB_STATUS
    bool "Widget for displaying the RGB backlight status"
    depends on !ZMK_SPLIT || ZMK_SPLIT_ROLE_CENTRAL
    select LVGL_USE_LABEL

endmenu
```
